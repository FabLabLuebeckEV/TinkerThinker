## sdkconfig.defaults
```kconfig
#
# ESP32 options
#
# Re-enable OPTIMIZATION_PERF when these bugs are fixed:
# https://github.com/espressif/arduino-esp32/issues/9784
# https://github.com/espressif/arduino-esp32/issues/9607
#CONFIG_COMPILER_OPTIMIZATION_PERF=y

CONFIG_ESPTOOLPY_FLASHSIZE_8MB=y
CONFIG_ESPTOOLPY_FLASHSIZE="8MB"

CONFIG_ESP32_XTAL_FREQ_AUTO=y
CONFIG_PARTITION_TABLE_SINGLE_APP_LARGE=y

# Bluetooh related
CONFIG_BT_ENABLED=y
CONFIG_BT_CONTROLLER_ONLY=y
# Only BR/EDR, no BLE controller needed (saves 10-20 KB IRAM/DRAM)
CONFIG_BTDM_CTRL_MODE_BR_EDR_ONLY=y
# Should be, at least, one more than CONFIG_BLUEPAD32_MAX_DEVICES
# See: https://gitlab.com/ricardoquesada/bluepad32/-/issues/11
CONFIG_BTDM_CTRL_BR_EDR_MAX_ACL_CONN=3
CONFIG_BTDM_CTRL_BLE_MAX_CONN=0
CONFIG_BTDM_CTRL_BR_EDR_MAX_SYNC_CONN=0
CONFIG_BTDM_CTRL_AUTO_LATENCY=y
# BT Modem-Sleep: lets the coexist arbiter pause BT when WiFi needs to transmit
CONFIG_BTDM_CTRL_MODEM_SLEEP=y
CONFIG_BTDM_CTRL_MODEM_SLEEP_MODE_ORIG=y
CONFIG_BTDM_CTRL_LPCLK_SEL_MAIN_XTAL=y

CONFIG_ESP_COREDUMP_ENABLE_TO_FLASH=y

# MBEDTLS
CONFIG_MBEDTLS_PSK_MODES=y
CONFIG_MBEDTLS_KEY_EXCHANGE_PSK=y
CONFIG_MBEDTLS_KEY_EXCHANGE_DHE_PSK=y
CONFIG_MBEDTLS_KEY_EXCHANGE_ECDHE_PSK=y
CONFIG_MBEDTLS_KEY_EXCHANGE_RSA_PSK=y

#
# FreeRTOS
#
# Move FreeRTOS/Heap/Ringbuf from IRAM to Flash (saves 5-10 KB IRAM)
CONFIG_FREERTOS_PLACE_FUNCTIONS_INTO_FLASH=y
CONFIG_HEAP_PLACE_FUNCTION_INTO_FLASH=y
CONFIG_RINGBUF_PLACE_FUNCTIONS_INTO_FLASH=y
# Enable FreeRTOS stats formatting functions, needed for 'tasks' console command
CONFIG_FREERTOS_USE_TRACE_FACILITY=y
CONFIG_FREERTOS_USE_STATS_FORMATTING_FUNCTIONS=y
# Needed for ArduinoCore v2.0.5
CONFIG_FREERTOS_HZ=1000

#
# Bluepad32 Options
#
CONFIG_BLUEPAD32_PLATFORM_CUSTOM=y
CONFIG_BLUEPAD32_MAX_DEVICES=2
# Disable GAP Security to allow DualShock 3 clones to connect
CONFIG_BLUEPAD32_GAP_SECURITY=n
# Arduino Serial conflicts with the console
# To disable replace "y" with "n"
CONFIG_BLUEPAD32_USB_CONSOLE_ENABLE=n
# Brings too many issues with Arduino users. Disable it by default.
# Can be enabled via API.
CONFIG_BLUEPAD32_ENABLE_VIRTUAL_DEVICE_BY_DEFAULT=n
# BLE not needed - only BR/EDR controllers (DS3/DS4) used.
# UNI_ENABLE_BLE is hardcoded in uni_config.h for ESP32 (compile-time),
# but this Kconfig option controls runtime BLE scanning.
CONFIG_BLUEPAD32_ENABLE_BLE_BY_DEFAULT=n

#
# Arduino Options
#
CONFIG_AUTOSTART_ARDUINO=n
CONFIG_ARDUINO_SELECTIVE_COMPILATION=y
CONFIG_ARDUINO_SELECTIVE_BLE=n
CONFIG_ARDUINO_SELECTIVE_BluetoothSerial=n
# Complains about missing ESP-SR header when compiling on esp32-s3. Temporary disabled
CONFIG_ARDUINO_SELECTIVE_ESP_SR=n
# Cannot disable SimpleBLE since it is included from WiFiProv.cpp
#CONFIG_ARDUINO_SELECTIVE_SimpleBLE=n
# Disable unused Arduino libs (saves Flash)
CONFIG_ARDUINO_SELECTIVE_SD=n
CONFIG_ARDUINO_SELECTIVE_SD_MMC=n
CONFIG_ARDUINO_SELECTIVE_SPIFFS=n
CONFIG_ARDUINO_SELECTIVE_FFat=n
CONFIG_ARDUINO_SELECTIVE_NetBIOS=n

#
# Log level: WARN (reduces Flash string usage)
#
CONFIG_LOG_DEFAULT_LEVEL_WARN=y
CONFIG_LOG_DEFAULT_LEVEL=2

#
# BTstack
#
# Needs to be disabled for ESP32-C6
# See: https://github.com/bluekitchen/btstack/issues/599
#
```
